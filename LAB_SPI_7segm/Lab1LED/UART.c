 /* Microchip Technology Inc. and its subsidiaries.  You may use this software 
 * and any derivatives exclusively with Microchip products. 
 * 
 * THIS SOFTWARE IS SUPPLIED BY MICROCHIP "AS IS".  NO WARRANTIES, WHETHER 
 * EXPRESS, IMPLIED OR STATUTORY, APPLY TO THIS SOFTWARE, INCLUDING ANY IMPLIED 
 * WARRANTIES OF NON-INFRINGEMENT, MERCHANTABILITY, AND FITNESS FOR A 
 * PARTICULAR PURPOSE, OR ITS INTERACTION WITH MICROCHIP PRODUCTS, COMBINATION 
 * WITH ANY OTHER PRODUCTS, OR USE IN ANY APPLICATION. 
 *
 * IN NO EVENT WILL MICROCHIP BE LIABLE FOR ANY INDIRECT, SPECIAL, PUNITIVE, 
 * INCIDENTAL OR CONSEQUENTIAL LOSS, DAMAGE, COST OR EXPENSE OF ANY KIND 
 * WHATSOEVER RELATED TO THE SOFTWARE, HOWEVER CAUSED, EVEN IF MICROCHIP HAS 
 * BEEN ADVISED OF THE POSSIBILITY OR THE DAMAGES ARE FORESEEABLE.  TO THE 
 * FULLEST EXTENT ALLOWED BY LAW, MICROCHIP'S TOTAL LIABILITY ON ALL CLAIMS 
 * IN ANY WAY RELATED TO THIS SOFTWARE WILL NOT EXCEED THE AMOUNT OF FEES, IF 
 * ANY, THAT YOU HAVE PAID DIRECTLY TO MICROCHIP FOR THIS SOFTWARE.
 *
 * MICROCHIP PROVIDES THIS SOFTWARE CONDITIONALLY UPON YOUR ACCEPTANCE OF THESE 
 * TERMS. 
 */

/*******************************************************************************
  This source file has NOT been generated by the MHC
 *******************************************************************************/

/* 
 * File:   
 * Author: Based on main.c by Yuri Panchul 
 * Comments: Modified by Alex Dean
 * Revision history: 
 */

// *****************************************************************************
// *****************************************************************************
// Section: Included Files 
// *****************************************************************************
// *****************************************************************************

#include "UART.h"

// *****************************************************************************
// *****************************************************************************
// Section: Global Data Definitions
// *****************************************************************************
// *****************************************************************************

#define LD1_PORT_BIT        LATGbits.LATG6
#define LD2_PORT_BIT        LATDbits.LATD4
#define LD3_PORT_BIT        LATBbits.LATB11
#define LD4_PORT_BIT        LATGbits.LATG15

// *****************************************************************************
// *****************************************************************************
// Section: User Functions
// *****************************************************************************
// *****************************************************************************

void UART1_init (void)
{
    TRISDbits.TRISD3 = 0;
    TRISCbits.TRISC1 = 1;
    
    ANSELCbits.ANSC1 = 0;
    
    
    // Set directions to output
    TRISGbits.TRISG6 = 0;
    TRISBbits.TRISB11 = 0;
    TRISGbits.TRISG15 = 0;
    TRISDbits.TRISD4 = 0;
    // Turn off LEDs for initialization
    LD1_PORT_BIT = 0;
    LD2_PORT_BIT = 0;
    LD3_PORT_BIT = 0;
    LD4_PORT_BIT = 0;
    
//    TRISDbits.TRISD3 = 1;
//    TRISCbits.TRISC1 = 1;
    
    RPD3R = 1; // PPS for U1RX from pin F2
    U1RXR = 10; // PPS for U1TX to pin F8
    
    U1MODEbits.PDSEL0 = 0;
    U1MODEbits.PDSEL1 = 0;
    U1MODEbits.STSEL = 0;

    //    U1MODEbits.LPBACK = 0;//??????
    
    U1STAbits.UTXEN = 1;   // enable transmit pin
    U1STAbits.URXEN = 1;   // enable receive pin
    U1BRG           = ((100 * 1000000) / (16 * 115200)) - 1;
    U1MODEbits.ON   = 1;   // enable UART
}

char UART1_getc(void) {
    while (!U1STAbits.URXDA)
        ; // wait until character received
    return U1RXREG; // read character
}

void UART1_gets(char* s) {
    int i = 0;
    int j = 0;
    char temp = 0;
    char S_temp[8];
    for(j = 0; j < i; j++)
    {
        s[j] = 0xF;
    }
    while (temp != 'E')
    {
        temp = UART1_getc();
        if (i < 8 && temp != 'E') 
        {
            S_temp[i] = temp;
            i++;
        }
    }
    for(j = 0; j < i; j++){
        s[8 - i + j] = S_temp[j];
    }
}

void UART1_putc (char c)
{
    while (U1STAbits.UTXBF)
        ;  // wait until transmit buffer not full
    U1TXREG = c;  // transmit character
}

/**
 * 
 */
void UART1_puts (char *s)
{
    while (*s != '\0')
        UART1_putc (*s++);
}


// Comment a function definition and leverage automatic documentation 
/**
  <p><b>Function:</b></p>

  <p><b>Summary:</b></p>

  <p><b>Description:</b></p>

  <p><b>Remarks:</b></p>
 */
// TODO Insert function definitions (right here) to leverage live documentation
void UART1_test (void)
{
    char c;

    UART1_puts("Hello, World!\r\n");
    UART1_puts("Please press a key 1-4.\r\n");
    
    for (;;)
    {
        c = UART1_getc();
        UART1_putc('[');
        UART1_putc (c);
        UART1_puts("]\r\n"); 
        switch (c) {
                case '1':
                    if (LD1_PORT_BIT == 0) LD1_PORT_BIT = 1; 
                        else LD1_PORT_BIT = 0;    
                    break;
                case '2':
                    if (LD2_PORT_BIT == 0) LD2_PORT_BIT = 1; 
                        else LD2_PORT_BIT = 0;  
                    break;    
                case '3':
                    if (LD3_PORT_BIT == 0) LD3_PORT_BIT = 1; 
                        else LD3_PORT_BIT = 0;  
                    break;
                case '4':
                    if (LD4_PORT_BIT == 0) LD4_PORT_BIT = 1; 
                        else LD4_PORT_BIT = 0;  
                    break; 
        }
    }
}

