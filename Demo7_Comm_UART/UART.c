 /* Microchip Technology Inc. and its subsidiaries.  You may use this software 
 * and any derivatives exclusively with Microchip products. 
 * 
 * THIS SOFTWARE IS SUPPLIED BY MICROCHIP "AS IS".  NO WARRANTIES, WHETHER 
 * EXPRESS, IMPLIED OR STATUTORY, APPLY TO THIS SOFTWARE, INCLUDING ANY IMPLIED 
 * WARRANTIES OF NON-INFRINGEMENT, MERCHANTABILITY, AND FITNESS FOR A 
 * PARTICULAR PURPOSE, OR ITS INTERACTION WITH MICROCHIP PRODUCTS, COMBINATION 
 * WITH ANY OTHER PRODUCTS, OR USE IN ANY APPLICATION. 
 *
 * IN NO EVENT WILL MICROCHIP BE LIABLE FOR ANY INDIRECT, SPECIAL, PUNITIVE, 
 * INCIDENTAL OR CONSEQUENTIAL LOSS, DAMAGE, COST OR EXPENSE OF ANY KIND 
 * WHATSOEVER RELATED TO THE SOFTWARE, HOWEVER CAUSED, EVEN IF MICROCHIP HAS 
 * BEEN ADVISED OF THE POSSIBILITY OR THE DAMAGES ARE FORESEEABLE.  TO THE 
 * FULLEST EXTENT ALLOWED BY LAW, MICROCHIP'S TOTAL LIABILITY ON ALL CLAIMS 
 * IN ANY WAY RELATED TO THIS SOFTWARE WILL NOT EXCEED THE AMOUNT OF FEES, IF 
 * ANY, THAT YOU HAVE PAID DIRECTLY TO MICROCHIP FOR THIS SOFTWARE.
 *
 * MICROCHIP PROVIDES THIS SOFTWARE CONDITIONALLY UPON YOUR ACCEPTANCE OF THESE 
 * TERMS. 
 */

/*******************************************************************************
  This source file has NOT been generated by the MHC
 *******************************************************************************/

/* 
 * File:   
 * Author: Based on main.c by Yuri Panchul 
 * Comments: Modified by Alex Dean
 * Revision history: 
 */

// *****************************************************************************
// *****************************************************************************
// Section: Included Files 
// *****************************************************************************
// *****************************************************************************

#include "UART.h"

// *****************************************************************************
// *****************************************************************************
// Section: Global Data Definitions
// *****************************************************************************
// *****************************************************************************

#define LD1_PORT_BIT        LATGbits.LATG6
#define LD2_PORT_BIT        LATDbits.LATD4
#define LD3_PORT_BIT        LATBbits.LATB11
#define LD4_PORT_BIT        LATGbits.LATG15

// *****************************************************************************
// *****************************************************************************
// Section: User Functions
// *****************************************************************************
// *****************************************************************************

void UART4_init (void)
{
    // Set directions to output
    TRISGbits.TRISG6 = 0;
    TRISBbits.TRISB11 = 0;
    TRISGbits.TRISG15 = 0;
    TRISDbits.TRISD4 = 0;
    // Turn off LEDs for initialization
    LD1_PORT_BIT = 0;
    LD2_PORT_BIT = 0;
    LD3_PORT_BIT = 0;
    LD4_PORT_BIT = 0;
    
    RPF8R = 2; // PPS for U4RX from pin F2
    U4RXR = 11; // PPS for U4TX to pin F8
    
    U4STAbits.UTXEN = 1;   // enable transmit pin
    U4STAbits.URXEN = 1;   // enable receive pin
    U4BRG           = ((100 * 1000000) / (16 * 115200)) - 1;
    U4MODEbits.ON   = 1;   // enable UART
}

char UART4_getc(void) {
    while (!U4STAbits.URXDA)
        ; // wait until character received
    return U4RXREG; // read character
}

void UART4_putc (char c)
{
    while (U4STAbits.UTXBF)
        ;  // wait until transmit buffer not full
    U4TXREG = c;  // transmit character
}

/**
 * 
 */
void UART4_puts (char *s)
{
    while (*s != '\0')
        UART4_putc (*s++);
}


// Comment a function definition and leverage automatic documentation 
/**
  <p><b>Function:</b></p>

  <p><b>Summary:</b></p>

  <p><b>Description:</b></p>

  <p><b>Remarks:</b></p>
 */
// TODO Insert function definitions (right here) to leverage live documentation
void UART4_test (void)
{
    char c;

    UART4_puts("Hello, World!\r\n");
    UART4_puts("Please press a key 1-4.\r\n");
    
    for (;;)
    {
        c = UART4_getc();
        UART4_putc('[');
        UART4_putc (c);
        UART4_puts("]\r\n"); 
        switch (c) {
                case '1':
                    if (LD1_PORT_BIT == 0) LD1_PORT_BIT = 1; 
                        else LD1_PORT_BIT = 0;    
                    break;
                case '2':
                    if (LD2_PORT_BIT == 0) LD2_PORT_BIT = 1; 
                        else LD2_PORT_BIT = 0;  
                    break;    
                case '3':
                    if (LD3_PORT_BIT == 0) LD3_PORT_BIT = 1; 
                        else LD3_PORT_BIT = 0;  
                    break;
                case '4':
                    if (LD4_PORT_BIT == 0) LD4_PORT_BIT = 1; 
                        else LD4_PORT_BIT = 0;  
                    break; 
        }
    }
}

